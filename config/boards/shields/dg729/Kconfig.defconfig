## config/dts/bindings/behaviors/zmk,behavior-ir-nec.yaml
```yaml
description: IR NEC Code Sender Behavior

compatible: "zmk,behavior-ir-nec"

properties:
  "#binding-cells":
    type: int
    required: true
    const: 1

  code:
    type: int
    required: false
    description: IR NEC code to send

binding-cells:
  - ir_code

include: base.yaml
```

## config/dts/bindings/ir/zmk,ir-nec.yaml
```yaml
description: ZMK NEC IR transmitter driver

compatible: "zmk,ir-nec"

properties:
  ir-gpios:
    type: phandle-array
    required: true
    description: GPIO pin connected to the IR LED
```
